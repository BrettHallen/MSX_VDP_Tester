/* NOTE! Generated by Claude */
/* Not yet reviewed, cleaned up or even tested */
/* Brett Hallen, 3/Jul/2026 */

/*
 * ============================================================================
 *  V9958 / V9938 VDP Authenticity Tester  --  ARDUINO UNO / NANO (ATmega328P)
 *
 *  Uno and Nano share the ATmega328P, so the pin map and direct-port code are
 *  identical. NOTE: on the Nano, A6/A7 are ADC-input-only and CANNOT be used
 *  as digital I/O -- do not move any control line onto them.
 * ============================================================================
 *
 *  Reads the Yamaha VDP's built-in version ID (status register S#1, bits 1-5,
 *  the "ID#" field per datasheet section 5.2) to tell a genuine V9958 apart
 *  from a relabeled V9938 or a dead / non-responding chip.
 *
 *      ID = 0  ->  V9938
 *      ID = 1  ->  V9948   (rare Korean variant)
 *      ID = 2  ->  V9958   <-- a genuine MSX2+ chip returns this
 *      ID = 3  ->  V9968
 *      ID = 4  ->  V9978
 *
 *  Press the push button to run a test; results print to the Serial Monitor
 *  at 115200 baud.
 *
 * ----------------------------------------------------------------------------
 *  WHY THIS VERSION USES DIRECT PORT I/O (important)
 * ----------------------------------------------------------------------------
 *  Datasheet 7.3.5 gives /CSR and /CSW a MAXIMUM pulse width of 2000 ns.
 *  A normal digitalRead() of 8 pins takes ~30 us and would violate that.
 *  So the data bus and strobes are driven with direct AVR port registers,
 *  keeping every strobe pulse well under a microsecond.
 *
 *  CONSEQUENCE: the pin assignments below are NOT freely reassignable -- they
 *  are chosen so the data bus lands on specific AVR port bits. If you move a
 *  pin you must update the bit math in readDataBus()/writeDataBus().
 *
 * ----------------------------------------------------------------------------
 *  CLOCK REQUIRED  (the VDP does nothing until its XTAL input is clocked)
 * ----------------------------------------------------------------------------
 *  The Arduino cannot generate this clock. Use ONE of two mutually exclusive
 *  options; frequency must be in the 20.26 - 22.55 MHz range (datasheet 7.3.1),
 *  and 21.477 MHz (standard MSX) is ideal:
 *
 *  OPTION A - CRYSTAL (uses the VDP's on-chip oscillator; datasheet section 8
 *             reference circuit). A passive crystal cannot run on its own, so
 *             it connects ACROSS both pins and relies on the internal amp:
 *                 XTAL1 (63) --+--[ 21.477 MHz crystal ]-+-- XTAL2 (64)
 *                              |                         |
 *                             ===  C                    ===  C
 *                              |                         |
 *                             GND                       GND
 *             Use a PARALLEL crystal with a specified load cap CL (e.g. 18pF)
 *             and size each C ~= 2*(CL - Cstray), Cstray ~3-5pF: CL=18pF -> ~27pF,
 *             CL=20pF -> ~33pF. (A series-resonant crystal will run slightly high
 *             but still works here.) The fuller V9938 data book appendix "Clock
 *             oscillation internal circuitry" gives Yamaha's recommended network.
 *
 *  OPTION B - ACTIVE OSCILLATOR MODULE (self-powered "can"; replaces the
 *             on-chip oscillator, so there is NO crystal and NO load caps):
 *                 module output -> XTAL1 (63),   XTAL2 (64) -> open
 *             Robust on a breadboard. The datasheet is terse on the external-
 *             clock path (7.3.1 lists both XTAL1 and XTAL2), so if the liveness
 *             check reports NO RESPONSE, try driving XTAL2 instead, or use A.
 *
 * ----------------------------------------------------------------------------
 *  WIRING  (VDP pin numbers from the V9958 Technical Data Book)
 * ----------------------------------------------------------------------------
 *    CD0(40)->D2  CD1(39)->D3  CD2(38)->D4  CD3(37)->D5
 *    CD4(36)->D6  CD5(35)->D7  CD6(34)->D8  CD7(32)->D9
 *        (CD0..CD5 = PORTD bits 2..7,  CD6..CD7 = PORTB bits 0..1)
 *    /CSR(31)->A0   /CSW(30)->A1   MODE0(29)->A2   MODE1(28)->A3
 *        (order matches V9958 pins 31..28 so traces run straight, no vias)
 *    /RESET(9)->A4                       (strobes/mode/reset = PORTC 0..4)
 *    Button -> D10 to GND (internal pull-up)     LED -> D13 (onboard)
 *    7-seg via 74HC595 (pin names shown NXP / TI). Nano -> 595:
 *        D11 -> pin14  DS/SER    (serial data)
 *        D12 -> pin11  SHCP/SRCLK (shift clock)
 *        A5  -> pin12  STCP/RCLK  (latch)
 *    595 static pins: pin16 VCC->+5V   pin8 GND->GND
 *        pin13 /OE->GND (outputs enabled)   pin10 /MR->+5V (no reset)
 *        pin9 Q7S/QH' (serial-out) -> open (only used to chain a 2nd digit)
 *    595 outputs -> COMMON-CATHODE segments, each via ~470R resistor
 *    (HDSP-7803 green: ~5 mA/seg, ~30 mA worst case through the 595)
 *    (NOTE: Q0 is pin 15, NOT next to Q1..Q7 which are pins 1..7):
 *        pin15 Q0->a  pin1 Q1->b  pin2 Q2->c  pin3 Q3->d
 *        pin4  Q4->e  pin5 Q5->f  pin6 Q6->g  pin7 Q7->DP
 *        digit common cathodes -> GND. 100nF across 595 VCC/GND.
 *    Display: 0-4 = VDP ID, DP lit = genuine V9958, '-' = no response,
 *        'E' = error (unstable or unrecognized ID).
 *    XTAL1(63) / XTAL2(64) -> clock: see CLOCK REQUIRED above (crystal across
 *        both pins, OR an oscillator module into XTAL1 with XTAL2 open)
 *    VDD(58)+VDD/DAC(21) -> +5V     GND(1)+GND/DAC(20) -> GND
 *    /INT(25), /WAIT(26), all VRAM/RGB/sync/color-bus pins -> open
 *
 *  Power the VDP from a bench 5V supply (up to 230 mA, datasheet 7.3.2),
 *  common ground with the Uno. VRAM is not required for an ID read.
 *
 *  Port select truth table (MODE1,MODE0):
 *    00 = VRAM   01 = status read / register write (used here)
 *    10 = palette   11 = register pointer / indirect
 * ============================================================================
 */

#include <avr/io.h>

// -------- PORTC bit positions for control lines (A0..A4) --------
// Order chosen to match the V9958 pin sequence (31,30,29,28) so the PCB
// traces run straight with no crossings/vias.
#define BIT_CSR    0   // A0  -> /CSR   (read strobe,  active LOW)
#define BIT_CSW    1   // A1  -> /CSW   (write strobe, active LOW)
#define BIT_MODE0  2   // A2  -> MODE0  (port-select bit 0)
#define BIT_MODE1  3   // A3  -> MODE1  (port-select bit 1)
#define BIT_RESET  4   // A4  -> /RESET (active LOW)

#define PIN_BUTTON 10  // PB2, INPUT_PULLUP
#define PIN_LED    13  // PB5, onboard LED

// -------- 7-segment display via one 74HC595 (3 pins) --------
// Common-cathode single digit. 595 Qn -> segment via resistor; commons -> GND.
//   Q0->a  Q1->b  Q2->c  Q3->d  Q4->e  Q5->f  Q6->g  Q7->decimal point
#define SEG_DATA  11   // D11 -> 595 DS   (pin 14)
#define SEG_CLK   12   // D12 -> 595 SHCP (pin 11, shift clock)
#define SEG_LATCH A5   // A5  -> 595 STCP (pin 12, latch)

// Segment bitmaps (bit0=a .. bit6=g, bit7=DP). Segment lit = bit set.
const uint8_t SEG_DIGIT[5] = { 0x3F, 0x06, 0x5B, 0x4F, 0x66 }; // '0'..'4'
const uint8_t SEG_DASH  = 0x40;  // '-'  : no response
const uint8_t SEG_E     = 0x79;  // 'E'  : error (unstable / unrecognized ID)
const uint8_t SEG_DP    = 0x80;  // decimal point : genuine-V9958 flag
const uint8_t SEG_BLANK = 0x00;

const uint8_t PORT_CMD = 1;   // VDP status-read / register-write port

// -------- Inter-access spacing (datasheet 7.3.5) --------
// TW1W / TS1WR / TW1R minimums are 2 us; use 3 us for margin.
const uint8_t T_GAP_US = 3;

// Short spin >= data-access time (TRAC max 150 ns) and >= min strobe width
// (186 ns). Six NOPs at 16 MHz ~= 375 ns, comfortably inside the 2000 ns max.
static inline void tinyWait() {
  __asm__ __volatile__("nop\n nop\n nop\n nop\n nop\n nop\n");
}

// ============================================================
//  Data bus  (CD0..CD5 = PORTD[2..7], CD6..CD7 = PORTB[0..1])
// ============================================================

static inline void dataBusOutput() {
  DDRD |= 0xFC;                    // PD2..PD7 outputs (preserve PD0/PD1 serial)
  DDRB |= 0x03;                    // PB0..PB1 outputs
}

static inline void dataBusInput() {
  DDRD &= 0x03;                    // PD2..PD7 inputs
  DDRB &= 0xFC;                    // PB0..PB1 inputs
  PORTD &= 0x03;                   // no pull-ups on the bus (true hi-Z)
  PORTB &= 0xFC;                   // clears only PB0/PB1 (keeps button/LED)
}

static inline void writeDataBus(uint8_t v) {
  PORTD = (PORTD & 0x03) | ((v << 2) & 0xFC);   // CD0..CD5
  PORTB = (PORTB & 0xFC) | ((v >> 6) & 0x03);   // CD6..CD7
}

static inline uint8_t readDataBus() {
  return (uint8_t)((PIND >> 2) | (PINB << 6));  // reassemble CD0..CD7
}

// ============================================================
//  Control lines
// ============================================================

static inline void selectPort(uint8_t p) {
  // MODE0 = PC2 (port bit 0), MODE1 = PC3 (port bit 1); preserve CSR/CSW/RESET.
  PORTC = (PORTC & ~0x0C) | ((p & 0x03) << 2);
}

// Write one byte to a VDP port. Data is latched on the /CSW rising edge.
void vdpWrite(uint8_t port, uint8_t v) {
  selectPort(port);
  dataBusOutput();
  writeDataBus(v);
  tinyWait();                      // address/data setup (TASW/TDSW 30 ns)
  PORTC &= ~_BV(BIT_CSW);          // /CSW low
  tinyWait();                      // /CSW pulse (>=186 ns, <=2000 ns)
  PORTC |=  _BV(BIT_CSW);          // /CSW high -> latch
  tinyWait();                      // data/address hold (TDHW/TAHW)
  dataBusInput();                  // release bus
}

// Read one byte from a VDP port. Bus is valid while /CSR is low.
uint8_t vdpRead(uint8_t port) {
  selectPort(port);
  dataBusInput();
  PORTC &= ~_BV(BIT_CSR);          // /CSR low
  tinyWait();                      // wait data-access time (TRAC max 150 ns)
  uint8_t v = readDataBus();       // single fast port read
  PORTC |=  _BV(BIT_CSR);          // /CSR high  (total low time < 2000 ns)
  return v;
}

// ============================================================
//  VDP operations
// ============================================================

// Point the status-register pointer (R#15) at register n via the
// two-byte control write: [data] then [0x80 | regNumber].
void selectStatusRegister(uint8_t n) {
  vdpWrite(PORT_CMD, n);
  delayMicroseconds(T_GAP_US);     // TW1W: /CSW high >= 2 us between bytes
  vdpWrite(PORT_CMD, 0x80 | 15);
  delayMicroseconds(T_GAP_US);     // TS1WR: >= 2 us before a read
}

uint8_t readStatusRegister(uint8_t n) {
  selectStatusRegister(n);
  return vdpRead(PORT_CMD);
}

void resetVDP() {
  PORTC &= ~_BV(BIT_RESET);        // /RESET low
  delay(15);                       // datasheet 7.3.1: >= 10 ms
  PORTC |=  _BV(BIT_RESET);        // /RESET high
  delay(10);                       // let the chip initialize
  vdpRead(PORT_CMD);               // dummy read: force byte-pair latch known
  delayMicroseconds(T_GAP_US);
}

// Confirm the chip is alive and clocked by watching S#2's retrace flags
// (VR = bit6, HR = bit5) toggle. A dead/floating bus never toggles them,
// so an all-zeros read cannot masquerade as a genuine V9938 (ID 0).
bool vdpIsAlive() {
  selectStatusRegister(2);         // point at S#2 (stays put across reads)
  uint8_t orAll = 0x00, andAll = 0xFF;
  unsigned long start = millis();
  while (millis() - start < 150) {
    uint8_t s2 = vdpRead(PORT_CMD);
    orAll  |= s2;
    andAll &= s2;
    delayMicroseconds(T_GAP_US);   // TW1R: /CSR high >= 2 us between reads
  }
  uint8_t toggled = orAll & (uint8_t)~andAll;
  return (toggled & 0b01100000) != 0;
}

// Read S#1 several times and confirm the ID field is stable. A flaky or
// floating bus gives an inconsistent ID and is reported as inconclusive.
bool readVdpId(uint8_t &idOut, uint8_t &s1Out) {
  uint8_t id = 0;
  bool stable = true;
  for (uint8_t i = 0; i < 8; i++) {
    uint8_t s1 = readStatusRegister(1);
    uint8_t thisId = (s1 >> 1) & 0x1F;
    if (i == 0) { id = thisId; s1Out = s1; }
    else if (thisId != id) { stable = false; }
    delayMicroseconds(T_GAP_US);
  }
  idOut = id;
  return stable;
}

// ============================================================
//  Test + reporting
// ============================================================

// Latch an 8-bit segment pattern into the 74HC595 (display update is not
// timing-critical, so plain shiftOut is fine here).
void showSegments(uint8_t pattern) {
  digitalWrite(SEG_LATCH, LOW);
  shiftOut(SEG_DATA, SEG_CLK, MSBFIRST, pattern);
  digitalWrite(SEG_LATCH, HIGH);
}

void runTest() {
  digitalWrite(PIN_LED, HIGH);
  Serial.println();
  Serial.println(F("=== Running VDP test ==="));

  resetVDP();

  if (!vdpIsAlive()) {
    showSegments(SEG_DASH);
    Serial.println(F("RESULT: NO RESPONSE - chip not detected."));
    Serial.println(F("  Check +5V (VDD pin 58 and VDD/DAC pin 21), the"));
    Serial.println(F("  21.477MHz clock on XTAL1 (try XTAL2), /RESET, and"));
    Serial.println(F("  the CD0-CD7 / MODE / strobe wiring."));
    Serial.println(F("========================"));
    digitalWrite(PIN_LED, LOW);
    return;
  }

  uint8_t id = 0, s1 = 0;
  bool stable = readVdpId(id, s1);

  Serial.print(F("S#1 raw   : 0x"));
  if (s1 < 0x10) Serial.print('0');
  Serial.println(s1, HEX);
  Serial.print(F("VDP ID    : "));
  Serial.println(id);

  if (!stable) {
    showSegments(SEG_E);
    Serial.println(F("RESULT    : INCONCLUSIVE - ID unstable across reads."));
    Serial.println(F("  Chip responds but the reading is not consistent."));
    Serial.println(F("  Suspect a wiring/contact fault or a marginal bus."));
    Serial.println(F("========================"));
    digitalWrite(PIN_LED, LOW);
    return;
  }

  Serial.print(F("RESULT    : "));
  switch (id) {
    case 0:
      showSegments(SEG_DIGIT[0]);
      Serial.println(F("V9938 (ID 0) - NOT a V9958."));
      Serial.println(F("  If sold as a V9958 it is almost certainly a"));
      Serial.println(F("  relabeled V9938."));
      break;
    case 1:
      showSegments(SEG_DIGIT[1]);
      Serial.println(F("V9948 (ID 1) - rare Korean variant, NOT a V9958."));
      break;
    case 2:
      showSegments(SEG_DIGIT[2] | SEG_DP);      // '2.'  genuine V9958
      Serial.println(F("GENUINE V9958 (ID 2). Behaves as a real V9958."));
      break;
    case 3:
      showSegments(SEG_DIGIT[3]);
      Serial.println(F("V9968 (ID 3) - NOT a classic V9958."));
      break;
    case 4:
      showSegments(SEG_DIGIT[4]);
      Serial.println(F("V9978 (ID 4) - NOT a classic V9958."));
      break;
    default:
      showSegments(SEG_E);
      Serial.print(F("UNKNOWN ID ("));
      Serial.print(id);
      Serial.println(F(") - alive but ID not recognized; possibly fake."));
      break;
  }
  Serial.println(F("========================"));
  digitalWrite(PIN_LED, LOW);
}

// ============================================================
//  Setup / loop
// ============================================================

void setup() {
  Serial.begin(115200);

  // Control lines (A0..A4) as outputs; idle levels:
  //   /CSR, /CSW, /RESET high (inactive), MODE = port 1 (MODE0=1, MODE1=0).
  DDRC |= 0x1F;
  PORTC = (PORTC & 0xE0)
        |  _BV(BIT_MODE0)                     // MODE0 = 1, MODE1 = 0 -> port 1
        |  _BV(BIT_CSR) | _BV(BIT_CSW) | _BV(BIT_RESET);

  dataBusInput();                             // bus released until we drive it

  pinMode(PIN_BUTTON, INPUT_PULLUP);          // D10 to GND
  pinMode(PIN_LED, OUTPUT);
  digitalWrite(PIN_LED, LOW);

  pinMode(SEG_DATA, OUTPUT);
  pinMode(SEG_CLK, OUTPUT);
  pinMode(SEG_LATCH, OUTPUT);
  showSegments(SEG_BLANK);                     // blank until first test

  Serial.println(F("V9958/V9938 VDP tester (Uno) ready."));
  Serial.println(F("Press the button to run a test."));
}

void loop() {
  if (digitalRead(PIN_BUTTON) == LOW) {       // active-low button
    delay(25);                                // debounce
    if (digitalRead(PIN_BUTTON) == LOW) {
      runTest();
      while (digitalRead(PIN_BUTTON) == LOW) { /* wait for release */ }
      delay(25);
      Serial.println(F("Press the button to test again."));
    }
  }
}
